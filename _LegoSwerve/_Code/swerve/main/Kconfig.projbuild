## _LegoSwerve/_Code/swerve/main/Kconfig.projbuild
```kconfig
menu "Example Configuration"

    config SERIAL_STUDIO_DEBUG
        bool "Enable log that can be parsed by Serial Studio"
        default "n"
        help
            Enable this option, the example will print a string at runtime with a specific format,
            which can be parsed by the Serial Studio tool.
            With the "serial-studio-dashboard.json" template file provided in this example,
            user can observe the speed in a curve window in the Serial Studio.
            
    orsource "$IDF_PATH/examples/common_components/env_caps/$IDF_TARGET/Kconfig.env_caps"

    config I2C_MASTER_SCL
        int "SCL GPIO Num"
        range ENV_GPIO_RANGE_MIN ENV_GPIO_OUT_RANGE_MAX
        default 4
        help
            GPIO number for I2C Master clock line.

    config I2C_MASTER_SDA
        int "SDA GPIO Num"
        range ENV_GPIO_RANGE_MIN ENV_GPIO_OUT_RANGE_MAX
        default 5
        help
            GPIO number for I2C Master data line.

    config I2C_MASTER_FREQUENCY
        int "Master Frequency"
        default 400000
        help
            I2C Speed of Master device.

endmenu
```
